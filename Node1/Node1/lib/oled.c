/*
 * oled.c
 *
 * Created: 27.09.2017 17:22:07
 *  Author: eddas, robbas og arras
 */ 


#define F_CPU 4915200UL
#include <util/delay.h>
#include "oled.h"
#include <stdlib.h>
#include <avr/io.h>
#include <avr/pgmspace.h>
#include "sram.h"

volatile char *OLEDC_ptr = (uint8_t *) 0x1000; // Command char* before
volatile char *OLEDD_ptr = (uint8_t *) 0x1200; // Data char* before

const unsigned char PROGMEM font[95][5];

void oled_init(){
	oled_writeCommand(0xae);        // Display  off
	oled_writeCommand(0xa1);        // Segment  remap
	oled_writeCommand(0xda);        // Common  pads  hardware:  alternative
	oled_writeCommand(0x12);
	oled_writeCommand(0xc8);        // Common output scan direction:com63~com0
	oled_writeCommand(0xa8);        // Multiplex  ration  mode:63
	oled_writeCommand(0x3f);
	oled_writeCommand(0xd5);        // Display divide ratio/osc. freq. mode
	oled_writeCommand(0x80);
	oled_writeCommand(0x81);        // Contrast control
	oled_writeCommand(0x50);
	oled_writeCommand(0xd9);        // Set pre-charge period
	oled_writeCommand(0x21);
	oled_writeCommand(0x20);        // Set Memory Addressing Mode
	oled_writeCommand(0x02);
	oled_writeCommand(0xdb);        // VCOM deselect level mode
	oled_writeCommand(0x30);
	oled_writeCommand(0xad);        // Master configuration
	oled_writeCommand(0x00);
	oled_writeCommand(0xa4);        // Out follows RAM content
	oled_writeCommand(0xa6);        // Set normal display
	oled_writeCommand(0xaf);        // Display on
	oled_reset();
}

void oled_reset(){
	for(int line = 0; line < 8; line++){
		oled_clearLine(line);
	}
}

void oled_clearLine(uint8_t line){
	oled_writeCommand(0xb0 + line); // Selecting row/page
	for(int byte = 0; byte < 128; byte++){
		OLEDD_ptr[0] = 0x00; // Clear current column
	}
}

void oled_bright(){
	for(int line = 0; line < 8; line++){
		oled_writeCommand(0xb0+line);
		for(int byte = 0; byte < 128; byte++){
			OLEDD_ptr[0] = 0xff;
		}
	}
}

void oled_writeCommand(uint8_t command){
	OLEDC_ptr[0] = command;
}

void oled_writeChar(char* str){
	uint8_t FONT_SIZE=5;
	for(uint8_t _col=0; _col < FONT_SIZE; _col++){
			*OLEDD_ptr = (pgm_read_byte(&(font[*str-32][_col])));
	}
}

void oled_writeCharInv(char* str){
	uint8_t FONT_SIZE=5;
	for(uint8_t _col=0; _col < FONT_SIZE; _col++){
		*OLEDD_ptr = ~(pgm_read_byte(&(font[*str-32][_col])));
	}
}




void oled_writeFromStartOnLine(int line){
		*OLEDC_ptr = 0xB0 + line;
		*OLEDC_ptr = 0x00;
		*OLEDC_ptr = 0x10;
}

void oled_writeString(char* str, int size, int inv){
	if (!inv){
		for (int i = 0; i < size; i++){
			oled_writeChar(str+i);
		}
	}
	else{
		for (int i = 0; i < size; i++){
			oled_writeCharInv(str+i);
		}
	}
	
	
}

const unsigned char PROGMEM font[95][5] = {
	{0b00000000,0b00000000,0b00000000,0b00000000,0b00000000}, //   
	{0b00000000,0b00000000,0b01011110,0b00000000,0b00000000}, // ! 
	{0b00000000,0b00001110,0b00000000,0b00001110,0b00000000}, // " 
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	{0b00000100,0b00000010,0b00000100,0b00000010,0b00000000}, // ~ 
};

const unsigned int byggern[1024] PROGMEM = {
	0xFF, 0x01, 0xFD, 0xFD, 0xFD, 0xFD, 0xFD, 0xFD, 0xFD, 0xFD,
	0xFD, 0xFD, 0xFD, 0xFD, 0xFD, 0xFD, 0xFD, 0x7D, 0x7D, 0x7D,
	0x7D, 0x7D, 0x7D, 0xFD, 0xFD, 0x7D, 0x7D, 0x7D, 0xFD, 0xFD,
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	0xBF, 0xBF, 0x80, 0xFF
};

#define FREE_SPACE_SRAM 500

void oled_writePic(){
	oled_writeFromStartOnLine(0);
	volatile char *ext_ram = (char *) 0x1800;							// Start address for the SRAM
	for(int line = 0; line < 8; line++){
		oled_writeCommand(0xb0+line);
		for(int byte = 0; byte < 128; byte++){
			OLEDD_ptr[0] = ext_ram[(128*line + byte)+FREE_SPACE_SRAM];	// ext_ram[line+byte+EMPTY_SPACE_SRAM];
		}
	}
}

void oled_fillSram(){
	volatile char *ext_ram = (char *) 0x1800;							// Start address for the SRAM
	for (int i = 0; i < 1024; i++){
		ext_ram[i+FREE_SPACE_SRAM] = ~pgm_read_byte(&(byggern[i]));
	}
}

void oled_printGame(int score,int lives){
	oled_writeFromStartOnLine(0);
	oled_writeString(" Game running!!  ",16,0);
	oled_writeFromStartOnLine(3);
	for (int i = 0; i < lives; i++){
		oled_writeString(" <3 ",4,0);
	}
	oled_writeFromStartOnLine(5);
	oled_writeString("Score: ",7,0);
	oled_printNumber(score);	
}

void oled_printGameTraining(int counter){
	oled_writeFromStartOnLine(0);
	oled_writeString(" Training mode  ",15,0);
	oled_writeFromStartOnLine(4);
	oled_writeString("Time left: ",11,0);
	oled_printNumber(counter);
}

void oled_printNumber(int number){
	if(number<0){
		oled_writeString("-",1,0);
		number=-number;
	}
	const int maxNumbDig=4;
	char dig[maxNumbDig];
	int asciiNumberOffset = 48;
	int numbDig=maxNumbDig;
	for (int i = 0; i < maxNumbDig; i++){
		dig[maxNumbDig-i-1]=(char) number%10 + asciiNumberOffset;
		number=number/10;
		if (number==0){
			numbDig=i+1;
			break;
		}
	}
	oled_writeString(dig+(maxNumbDig-numbDig),numbDig,0);
}

void oled_printNumberInverted(int number){
	if(number<0){
		oled_writeString("-",1,1);
		number=-number;
	}
	const int maxNumbDig=4;
	char dig[maxNumbDig];
	int asciiNumberOffset = 48;
	int numbDig=maxNumbDig;
	for (int i = 0; i < maxNumbDig; i++){
		dig[maxNumbDig-i-1]=(char) number%10 + asciiNumberOffset;
		number=number/10;
		if (number==0){
			numbDig=i+1;
			break;
		}
	}
	oled_writeString(dig+(maxNumbDig-numbDig),numbDig,1);
}



const unsigned char gameOver [] PROGMEM=
{
	0x00, 0x80, 0xE0, 0xF0, 0xF0, 0x30, 0x30, 0x30, 0x70, 0x70,
	0x60, 0x00, 0x00, 0x00, 0x80, 0xF0, 0xF0, 0x70, 0xF0, 0xF0,
	0xE0, 0x80, 0x00, 0x00, 0x00, 0xF0, 0xF0, 0xF0, 0xF0, 0xF0,
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	0x0F, 0x0F, 0x0C, 0x00
};

#define imageWidth 51
#define imageHeight 32

void oled_printGameOver(){
	oled_reset();
	oled_writeFromStartOnLine(0);
	int startPrintingWidth = 38;
	int startPrintingLine = 2;
	for(int line = 0; line < 8; line++){
		oled_writeCommand(0xb0+line);
		for(int byte = 0; byte < 128; byte++){
			if(byte < startPrintingWidth || byte > imageWidth+startPrintingWidth-1 || line < startPrintingLine || line > startPrintingLine + imageHeight/8 - 1){
				OLEDD_ptr[0] = 0x00;
			}
			else{
				OLEDD_ptr[0] = pgm_read_byte(&(gameOver[(line-startPrintingLine)*(imageWidth)+(byte-startPrintingWidth)]));
			}
		}
	}
	
}


const int maxNumbCharPrLine=25;
void oled_writeLongerText(int startLine, char* text){ //All text must end with '\0'
	char word[maxNumbCharPrLine];
	int wordLengthCounter=0;
	int textLengthCounter=0;
	int lineLengthCounter=0;
	char letter='a';
	oled_writeFromStartOnLine(startLine);
	while (letter!='\0'){
		wordLengthCounter=0;
		letter='a';
		while (letter!=' ' && letter!='\0'){
			letter=text[textLengthCounter];
			word[wordLengthCounter]=letter;
			textLengthCounter+=1;
			wordLengthCounter+=1;
		}
		if(lineLengthCounter+wordLengthCounter>maxNumbCharPrLine){
			startLine+=1;
			oled_writeFromStartOnLine(startLine);
			lineLengthCounter=0;
		}
		oled_writeString(word,wordLengthCounter,0);
		_delay_ms(20);			//Looks cool
		lineLengthCounter+=wordLengthCounter;
	}
}

void oled_printStartPage(){
	oled_reset();
	oled_writeFromStartOnLine(1);  //Printer startside
	oled_writeString("       Welcome ",15,0);
	oled_writeFromStartOnLine(2);
	oled_writeString("         to    ",15,0);
	oled_writeFromStartOnLine(3);
	oled_writeString("----PingPong Game---- ",21,0);
	oled_writeFromStartOnLine(4);
	oled_writeString("_____________________ ",21,0);
	oled_writeFromStartOnLine(7);
	oled_writeString("Next ",5,1);
}